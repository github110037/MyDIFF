## Kconfig
```kconfig
mainmenu "HIT DIFFTEST CONFIG"


menu "Build Options"# {{{
choice
  prompt "Compiler"
  default CC_GCC
config CC_GCC
  bool "gcc"
config CC_GPP
  bool "g++"
config CC_CLANG
  depends on !TARGET_AM
  bool "clang"
endchoice

config CC
  string
  default "gcc" if CC_GCC
  default "g++" if CC_GPP
  default "clang" if CC_CLANG
  default "none"

choice
  prompt "Optimization Level"
  default CC_O2
config CC_O0
  bool "O0"
config CC_O1
  bool "O1"
config CC_O2
  bool "O2"
config CC_O3
  bool "O3"
endchoice

config CC_OPT
  string
  default "-O0" if CC_O0
  default "-O1" if CC_O1
  default "-O2" if CC_O2
  default "-O3" if CC_O3
  default "none"

config CC_LTO
  depends on !TARGET_AM
  bool "Enable link-time optimization"
  default n

config CC_DEBUG
  bool "Enable debug information"
  default n

config CC_ASAN
  depends on MODE_SYSTEM
  bool "Enable address sanitizer"
  default n
endmenu# }}}

menu "AXI Options"# {{{

config AXI_DWID
int "AXI bus data channal width"
default 32

config AXI_AWID
int "AXI bus address channal width"
default 32

config AXI_IDWID
int "AXI bus xID signal width"
default 4
endmenu# }}}

menu "Perference Test"# {{{
config PERF_START
int "Start to run perference test from which program"
range 1 10
default 1

config PERF_END
int "Stop perference test after run which program"
range PERF_START 10
default 1

endmenu# }}}

menu "Wave Options"# {{{
config TRACE_ON
bool "log wave by file"
default y

choice
  prompt "Wave file extension"
  depends on TRACE_ON
  default EXT_FST
config EXT_VCD
  bool "vcd"
config EXT_FST
  bool "fst"
endchoice

endmenu# }}}

menu "Log Options"

config LOG_ENABLE
    bool "Save difftest output in a file"
    default y

config LOG_FILE
    depends on LOG_ENABLE
    string "log file absolutely path"
    default "$(DIFF_HOME)/vlogs/difftest-log.txt"

config LRING_ENABLE
    depends on LOG_ENABLE
    bool "Only save the last n log in file"
    default n

config LRING_NR 
    depends on LRING_ENABLE
    int "Save the last n log"
    default 1024


endmenu

config WAVE_EXT
  string
  default "vcd" if EXT_VCD
  default "fst" if EXT_FST
  default "none"
```
